## drivers/net/wireless/rtl8703as/Kconfig
```kconfig
config RTL8703AS
	tristate "Realtek 8723BS-VQ0 (8703AS) WiFi"
	---help---
	  Help message of RTL8723BS-VQ0 (8703AS)
```

## drivers/power/axp_power/Kconfig
```kconfig
menuconfig AW_AXP
	bool "AXP Power drivers"
	depends on REGULATOR
	default y
	---help---
	This option allows you to select AXP power driver

if AW_AXP

config AW_AXP81X
	bool "AXP81X driver"
	---help---
	AXP81X driver

config AW_AXP20
	bool "AXP20 driver"
	depends on I2C
	depends on AXP_TWI_USED
	---help---
	AXP20 driver

if AW_AXP20
choice
	prompt "AXP calculate type:"
	default AW_AXP20_COU

	config AW_AXP20_COU
		bool "COULOMB"
		---help---
			AXP driver for coulomb
	config AW_AXP20_OCV
		bool "OCV"
		---help---
			AXP driver for ocv
	config AW_AXP20_OCV_SMALL
		bool "OCV For small battery "
		---help---
			AXP driver for modify sampling resistance
endchoice
endif # !AW_AXP20

config AXP_TWI_USED
	bool "AXP use twi as transfer channel"
	default n

config AXP_NMI_USED
	bool "AXP use NMI as IRQ SRC"
	default n

endif # !AW_AXP
```

## drivers/power/axp_power_new/Kconfig
```kconfig
menuconfig AW_AXP_NEW
	bool "New AXP Power drivers"
	depends on REGULATOR
	depends on ARCH_SUN8IW10
	select MFD_CORE
	default y
	---help---
	This option allows you to select new AXP power driver

if AW_AXP_NEW

config AW_AXP152
	bool "AXP152 driver"
	---help---
	AXP152 driver

config AW_AXP22
	bool "AXP22x driver"
	---help---
	AXP22x driver
	
config AXP_TWI_USED
	bool "AXP use twi as transfer channel"
	default n

config AXP_NMI_USED
	bool "AXP use NMI as IRQ SRC"
	default n

endif # !AW_AXP
```
